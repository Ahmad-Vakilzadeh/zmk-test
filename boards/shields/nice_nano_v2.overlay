/ {
    backlight: backlight {
        compatible = "zmk,backlight-pwm";
        pwms = <&pwm0 13 5000 PWM_POLARITY_NORMAL>; // Change 13 to your LED pin
        label = "Backlight";
        brightness = <5>;
    };
};

&chosen {
    zmk,backlight = &backlight;
};
